## board/synexxus/ledgateway/Kconfig
```kconfig
if TARGET_LEDGATEWAY

config SYS_BOARD
	default "ledgateway"

config SYS_VENDOR
	default "synexxus"

config SYS_CONFIG_NAME
	default "ledgateway"

endif
```

## board/synexxus/rctu/Kconfig
```kconfig
if TARGET_RCTU

config SYS_BOARD
	default "rctu"

config SYS_VENDOR
	default "synexxus"

config SYS_CONFIG_NAME
	default "rctu"

endif
```
